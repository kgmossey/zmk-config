## boards/shields/coral_tree/Kconfig.shield
```kconfig
# Copyright (c) 2024 Kevin Mossey
# SPDX-License-Identifier: MIT

config SHIELD_CORAL_TREE_LEFT
    def_bool $(shields_list_contains,coral_tree_left)

config SHIELD_CORAL_TREE_RIGHT
    def_bool $(shields_list_contains,coral_tree_right)
```

## config/west.yml
```yaml
manifest:
  remotes:
    - name: kgmossey
      url-base: https://github.com/kgmossey
    # Additional modules containing boards/shields/custom code can be listed here as well
    # See https://docs.zephyrproject.org/3.5.0/develop/west/manifest.html#projects
  projects:
    - name: zmk
      remote: kgmossey
      revision: master
      import: app/west.yml
  self:
    path: config
```
